#include <dht.h>
#include <EEPROM.h>
#include "U8glib.h"
#include <SimpleKalmanFilter.h>
//#include <Arduino.h>

SimpleKalmanFilter simpleKalmanFilter(20, 20, 0.01); //Ajuste para o seu potenciometro o meu exigiu esses parametros para estabilizar a leitura

//Define pins
#define pinFAN 4
#define pinBed 7
#define pushButton 32
#define potentiometer A0

// Tela 1 - 128x64
U8GLIB_SSD1306_128X64 oled1(U8G_I2C_OPT_NO_ACK);
// Tela 2 - 128x64
U8GLIB_SSD1306_128X64 oled2(U8G_I2C_OPT_NO_ACK);
// Tela 3 - 128x32 
U8GLIB_SSD1306_128X32 oled3(U8G_I2C_OPT_NO_ACK);

// Pinos do arduino conectados as entradas de controle do demux
byte Dpin2 = 46;
byte Dpin3 = 44;
byte Dpin4 = 42;


const unsigned char screen01 [] PROGMEM = { 0x00, 0x00, 0x00, 0x00, 0x00, 0x00, 0x00, 0x00, 0x00, 0x00, 0x00, 0x00, 0x00,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 0x00, 0x00};

const unsigned char screen02 [] PROGMEM = { 0x00, 0x00, 0x00, 0x00, 0x00, 0x00, 0x00, 0x00, 0x00, 0x00, 0x00, 0x00, 0x00,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 0x00, 0x00};
//
const unsigned char screen03_defaultTemp [] PROGMEM = { 0x00, 0x00, 0x00, 0x00, 0x00, 0x00, 0x00, 0x00, 0x00, 0x00, 0x00, 0x00, 0x00,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 0x00, 0x00};

const unsigned char screen03_fanPorcent [] PROGMEM = { 0x00, 0x00, 0x00, 0x00, 0x00, 0x00, 0x00, 0x00, 0x00, 0x00, 0x00, 0x00, 0x00,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 0x00, 0x00};




//"instanciando" o dht22
#define pinDHT 8

dht sensorDHT;
byte dhtStatus = 1;
float temperature = 0.0;
float humidity = 0.0;
float humidityAbsolute = 0.0;

//Delay millis para atualizar leitura do sensor e ligar ou desligar hotbed
unsigned long ScreenPreviousMillis = 0, sensorPreviousMillis = 0;
const long ScreenInterval = 10000, delayControlTemp = 3000; //Intervalo Leitura da tela e do sensor


//Global variables
byte TemperatureAlvo, fanSpeed = 50, lastReadFanporcent = 0;
//eeprom 0 ABS
//eeprom 1 PETG
//eeprom 2 PLA








//Screens on Working
void PrintOnScreen(byte screen) {//Select screen to print
  if (screen == 1) {
    // Tela 1 (128x64)
    digitalWrite(Dpin2, LOW);
    digitalWrite(Dpin3, LOW);
    digitalWrite(Dpin4, LOW);
  }
  else if (screen == 2) {
    // Tela 2 (128x64)
    digitalWrite(Dpin2, HIGH);
    digitalWrite(Dpin3, LOW);
    digitalWrite(Dpin4, LOW);
  }
  else if (screen == 3) {
    // Tela 3 (128x32)
    digitalWrite(Dpin2, LOW);
    digitalWrite(Dpin3, HIGH);
    digitalWrite(Dpin4, LOW);
  }
}

void printOnscreen01(byte temperature, byte humidity){
  delay(500);
  PrintOnScreen(1);
  delay(500);
  oled1.firstPage();
  do {
    oled1.setColorIndex(1); // Define a cor como branco
    oled1.setFont(u8g_font_10x20);
    oled1.drawBitmapP( 0, 0, 16, 64, screen01);
    
    // Converte o número para uma string
    const char PROGMEM strTemp[5];  // Ajuste o tamanho conforme necessário
    sprintf(strTemp, "%d", temperature);

    const char PROGMEM strHum[5];  // Ajuste o tamanho conforme necessário
    sprintf(strHum, "%d", humidity);

    //Desloca o numero pra mais perto do % ou g/m3 conforme o tamnho dele
    byte x1 = 10;//temperature
    byte x2 = 80;//humidity
    if(temperature >= 100){
      x1 = 3;
    }
    if(humidity >= 100){
      x2 = 73;
    }

    oled1.drawBox(63, 0, 2, 64);

    oled1.drawStr(5, 13, "Temp.");
    oled1.drawStr(x1, 59, strTemp);
    
    //delay(100);

    oled1.drawStr(70, 13, "Humid.");
    oled1.drawStr(x2, 59, strHum);
    //delay(100);
    
  } while (oled1.nextPage());
}

void printOnscreen02(byte humidityAbsoulte, byte fanspeed){
  delay(500);
  PrintOnScreen(2);
  delay(500);
  oled2.firstPage();
  do {
    oled2.setColorIndex(1); // Define a cor como branco
    oled2.setFont(u8g_font_10x20);
    oled2.drawBitmapP( 0, 0, 16, 64, screen02);

    // Converte o número para uma string
    const char PROGMEM strHumAbs[5];  // Ajuste o tamanho conforme necessário
    sprintf(strHumAbs, "%d", humidityAbsoulte);

    const char PROGMEM strFan[5];  // Ajuste o tamanho conforme necessário
    sprintf(strFan, "%d", fanspeed);

    //Desloca o numero pra mais perto do % ou g/m3 conforme o tamnho dele
    byte x1 = 13;//humidityAbsolute
    byte x2 = 90;//FanSpeed
    if(humidityAbsoulte >= 100){
      x1 = 4;
    }
    if(fanspeed >= 100){
      x2 = 85;
    }

    oled2.drawBox(65, 0, 2, 64);

    oled2.drawStr(3, 13, "Humid.");
    oled2.drawStr(24, 29, "Abs.");
    oled2.drawStr(x1, 63, strHumAbs);

    //delay(100);

    oled2.drawStr(82, 13, "Fan");
    oled2.drawStr(x2, 61, strFan);
    //delay(100);
    
  } while (oled2.nextPage());
}


void printOnscreen03(byte defaultTemp){
  PrintOnScreen(3);

  oled3.firstPage();
  do {
    oled3.setColorIndex(1); // Define a cor como branco
    oled3.setFont(u8g_font_10x20);
    oled3.drawBitmapP( 0, 0, 16, 64, screen03_defaultTemp);
    delay(50);
    
    // Converte o número para uma string
    const char PROGMEM strDefTemp[5];  // Ajuste o tamanho conforme necessário
    sprintf(strDefTemp, "%d", defaultTemp);

    //Desloca o numero pra mais perto do °C conforme o tamnho dele
    byte x = 85;
    if(defaultTemp >= 100){
      x = 74;
    }

    oled3.drawStr(x, 25, strDefTemp);    
  } while (oled3.nextPage());
}


//Screen for menu
void smallScreenOneOption(const char* option){
  delay(250);
  PrintOnScreen(3);
  oled3.firstPage();
  do {
    //Desenha dois quadrados
    //Desenha um quadrado em volta da palavra
    oled3.setColorIndex(1); // Define a cor como branco
    oled3.drawBox(0, 0, 128, 32); // Desenha um retângulo preto na tela
    
    oled3.setColorIndex(0); // Define a cor como preto
    oled3.drawBox(3, 3, 128-6, 26);

    //
    oled3.setColorIndex(1); // Define a cor como branco
    oled3.setFont(u8g_font_10x20);

    //Escreve opções no centro e com a tela dividida------------------
    // Obtém a largura da palavra1 e palavra2
    byte larguraPalavra = oled3.getStrWidth(option);

    // Calcula a posição x para o alinhamento central
    byte x1 = (128 - larguraPalavra) / 2;

    // Desenha as palavras no display
    oled3.drawStr(x1, 20, option);
    
    
  } while (oled3.nextPage());
}

//Screen for FAN SPEED MENU
void smallScreenFanPorcent(byte fanPorcent){
  //delay(500);
  PrintOnScreen(3);
  oled3.firstPage();
  do {
    oled3.setColorIndex(1); // Define a cor como branco
    oled3.setFont(u8g_font_fub25);
    oled3.drawBitmapP( 0, 0, 16, 64, screen03_fanPorcent);
    
    // Converte o número para uma string
    const char PROGMEM strDefTemp[3];  // Ajuste o tamanho conforme necessário
    sprintf(strDefTemp, "%d", fanPorcent);

    //Desloca o numero pra mais perto do °C conforme o tamnho dele
    byte x = 55;
    if(fanPorcent >= 100){
      x = 38;
    }

    oled3.drawStr(x, 28, strDefTemp);
    
  } while (oled3.nextPage());
}



//Functions
byte chooseOption(const char* option1, const char* option2, const char* option3 = "", const char* option4 = ""){
  unsigned long lastDebounceTime = 0;
  byte option;
  byte potValue = 0, state = 1;

  if(option3 == ""){//Se tiver 2 opções escolhidas
    //---inicio
    while(true){
      
      if(potValue == 0 && state == 1){
        state = 0;
        option = 1;
        Serial.println(option1);
        smallScreenOneOption(option1);

      } else if(potValue == 1 && state == 0){
        state = 1;
        option = 2;
        Serial.println(option2);
        smallScreenOneOption(option2);

      }

      potValue = map(analogRead(potentiometer), 0, 1023, 0, 2);
        
      

      if (digitalRead(pushButton) == LOW) {
        return option;
      }

    }
    
    //---fim
  } else if(option4 == ""){//Se tiver 3 opções escolhidas 
    //---inicio
    while(true){
      
      if(potValue == 0 && state == 1){
        state = 0;
        option = 1;
        Serial.println(option1);
        smallScreenOneOption(option1);

      } else if( (potValue == 1 && state == 0) || (potValue == 1 && state == 2) ){
        state = 1;
        option = 2;
        Serial.println(option2);
        smallScreenOneOption(option2);

      } else if(potValue == 2 && state == 1 ){
        state = 2;
        option = 3;
        Serial.println(option3);
        smallScreenOneOption(option3);

      }

      potValue = map(analogRead(potentiometer), 0, 1023, 0, 3);


      if (digitalRead(pushButton) == LOW) {
        return option;
      }
    }
    
    //---fim
  }else if(option4 != ""){//Se tiver 4 opções escolhidas 
    //---inicio
    //Serial.println("4 opçoes");
    while(true){
      
      if(potValue == 0 && state == 1){
        state = 0;
        option = 1;
        Serial.println(option1);
        smallScreenOneOption(option1);

      } else if( (potValue == 1 && state == 0) || (potValue == 1 && state == 2) ){
        state = 1;
        option = 2;
        Serial.println(option2);
        smallScreenOneOption(option2);

      } else if( (potValue == 2 && state == 1) || (potValue == 2 && state == 3) ){
        state = 2;
        option = 3;
        Serial.println(option3);
        smallScreenOneOption(option3);

      } else if(potValue == 3 && state == 2 ){
        state = 3;
        option = 4;
        Serial.println(option4);
        smallScreenOneOption(option4);

      }

      potValue = map(analogRead(potentiometer), 0, 1023, 0, 4);


      if (digitalRead(pushButton) == LOW) {
        return option;
      }
    }
    
    //---fim
  }

}

byte chooseTemperature(){
  byte option;

  byte valorPotAnterior = 0, potValue = 0;

  while(true){

    if(potValue != valorPotAnterior){
      valorPotAnterior = potValue;

      option = potValue;
      Serial.println(potValue);

      const char PROGMEM strPotvalue[10];
      sprintf(strPotvalue, "%d C", potValue);
      smallScreenOneOption(strPotvalue);

    }
    int somaLeituras = 0;
    for (int i = 0; i < 100; i++) {
      int real_value = map(analogRead(potentiometer), 0, 1023, 24, 121);
      int measured_value = real_value + random(-5, 5);
      int estimated_value = simpleKalmanFilter.updateEstimate(measured_value);
      estimated_value = constrain(estimated_value, 24, 121);

      somaLeituras += estimated_value;// Calcula o valor estimado com o Filtro de Kalman e soma na variavel para tirar a media dps
    }
    potValue = somaLeituras / 100;

    

    

    if (digitalRead(pushButton) == LOW) {
      break;
    }
  }
  return option;
}


void initialMenu(void){
  //Use start or config values
  byte startOrConfig = chooseOption("Start", "Config");

  delay(200);

  if(startOrConfig == 2){//se a pessoa escolher configurar valores

    //Escolhe qual ela quer altera
    //atribuindo o valor salvo na eeprom a string antes de jogar na função que printará ela, ou seja ficará o nome da opção mais a temp dela
    char ABS[11], PETG[12], PLA[11];
    sprintf(ABS, "ABS - %d C", EEPROM.read(0));
    sprintf(PETG, "PETG - %d C", EEPROM.read(1));
    sprintf(PLA, "PLA - %d C", EEPROM.read(2));
    

    byte Option2configTemp = chooseOption(ABS, PETG, PLA, "Cancel");//retorna numeros de 1 a 4, referente aos parametros 1 é o primeiro parametro, 2 o segundo...
    

    delay(200);

    //atualiza temperatura
    if(Option2configTemp == 1){//ABS
      EEPROM.write(0, chooseTemperature());

    } else if(Option2configTemp == 2){//PETG
      EEPROM.write(1, chooseTemperature());

    } else if(Option2configTemp == 3){//PLA
      EEPROM.write(2, chooseTemperature());

    } 

  }

  delay(200);

  //Escolher um preset ou escolher temperatura manualmente
  byte operationMode = chooseOption("Preset", "Manual Temp");

  delay(200);

  if(operationMode == 1){
    //Escolha qual preset
    //atribuindo o valor salvo na eeprom a string antes de jogar na função que printará ela, ou seja ficará o nome da opção mais a temp dela
    const char PROGMEM ABS[11], PETG[12], PLA[11];
    sprintf(ABS, "ABS - %d", EEPROM.read(0));
    sprintf(PETG, "PETG - %d", EEPROM.read(1));
    sprintf(PLA, "PLA - %d", EEPROM.read(2));

    char PresetChoosed = chooseOption(ABS, PETG, PLA, "Cancel");

    if(PresetChoosed == 1){//ABS
      TemperatureAlvo = EEPROM.read(0);

    } else if(PresetChoosed == 2){//PETG
      TemperatureAlvo = EEPROM.read(1);

    } else if(PresetChoosed == 3){//PLA
      TemperatureAlvo = EEPROM.read(2);

    } 
    

  } else {
    //Escolhe uma temperatura manualmente
    TemperatureAlvo = chooseTemperature();
  }

}


void ReadDHT(){
  byte chk = sensorDHT.read22(pinDHT);

    // VERIFICA SE HOUVE ERRO
    switch (chk){// 1= ok   0= error
    case DHTLIB_OK:
        //Serial.print("OK,\t");
        dhtStatus = 1; 
        break;
    case DHTLIB_ERROR_CHECKSUM:
        //Serial.print("Checksum error,\t");
        dhtStatus = 0;
        break;
    case DHTLIB_ERROR_TIMEOUT:
        //Serial.print("Time out error,\t");
        dhtStatus = 0;
        break;
    case DHTLIB_ERROR_CONNECT:
        //Serial.print("Connect error,\t");
        dhtStatus = 0;
        break;
    case DHTLIB_ERROR_ACK_L:
        //Serial.print("Ack Low error,\t");
        dhtStatus = 0;
        break;
    case DHTLIB_ERROR_ACK_H:
        //Serial.print("Ack High error,\t");
        dhtStatus = 0;
        break;
    default:
        //Serial.print("Unknown error,\t");
        dhtStatus = 0;
        break;
    }

  
    // EXIBINDO DADOS LIDOS
    //Serial.print(stop - start); //printando quanto tempo levou para fazer a analise
    //Serial.print(", \t\t");
    //Serial.print(sensorDHT.humidity, 1 /*FORMATAÇÃO PARA UMA CASA DECIMAL*/);
    //Serial.print(",\t\t");
    //Serial.println(sensorDHT.temperature, 1 /*FORMATAÇÃO PARA UMA CASA DECIMAL*/);

    if(dhtStatus == 1){
      humidity = round(sensorDHT.humidity * 10) / 10; //essa conta é para salvar apenas 1 casa decimal na variavel humidity e abaixo na temperature
      temperature = round(sensorDHT.temperature * 10) / 10;
    }
    else if(dhtStatus == 0){
      humidity = 0.0;
      temperature = 0.0;
    }
}

float calculaUmidadeAbsoluta(byte temp, byte hum){
  //Constante Matemática de Euler
  float e = 2.718281828459045235360287471352;

  float UA = ((6.112 * (pow(e, ((17.67 * temp) / (temp + 243.5)))) *  hum * 2.1674) / (273.15 + temp));
  return UA;
}


byte FanSpeed(byte potenciometro){
  switch(potenciometro){
    case 0:
        analogWrite(pinFAN, 0);
        return 0;
        //break;
    case 10:
        analogWrite(pinFAN, 25.5);
        return 10;
        //break;
    case 20:
        analogWrite(pinFAN, 51);
        return 20;
        //break;
    case 30:
        analogWrite(pinFAN, 76.5);
        return 30;
        //break;
    case 40:
        analogWrite(pinFAN, 102);
        return 40;
        //break;
    case 50:
        analogWrite(pinFAN, 127.5);
        return 50;
        //break;
    case 60:
        analogWrite(pinFAN, 153);
        return 60;
        //break;
    case 70:
        analogWrite(pinFAN, 178.5);
        return 70;
        //break;
    case 80:
        analogWrite(pinFAN, 204);
        return 80;
        //break;
    case 90:
        analogWrite(pinFAN, 229.5);
        return 90;
        //break;
    case 100:
        analogWrite(pinFAN, 255);
        return 100;
        //break;
    case 110:
        analogWrite(pinFAN, 255);
        return 100;
        //break;
    case 120:
        analogWrite(pinFAN, 255);
        return 100;
        //break;
  }
}




void setup() {
  Serial.begin(9600);

  //Código abaixo referente as 3 telas
  //Declara os pinos do arduino como saídas(os de controle do demux)
  pinMode(Dpin2, OUTPUT);
  pinMode(Dpin3, OUTPUT);
  pinMode(Dpin4, OUTPUT);

  //----------------------------------------- Inicializa as telas e deixa em branco -------------------------------
  //Para inicializar o display 1
  PrintOnScreen(1);
  oled1.begin();
  oled1.firstPage();
  do {
    oled1.setColorIndex(0); // Define a cor como preto
    oled1.drawBox(0, 0, 128, 64); // Desenha um retângulo preto na tela
  } while (oled1.nextPage());
  oled1.setColorIndex(1);//white
  oled1.setFont(u8g_font_tpssb);//fonte

  //Para inicializar o display 2
  PrintOnScreen(2);
  oled2.begin();
  oled2.firstPage();
  do {
    oled2.setColorIndex(0); // Define a cor como preto
    oled2.drawBox(0, 0, 128, 64); // Desenha um retângulo preto na tela
  } while (oled2.nextPage());
  oled2.setColorIndex(1);//white
  oled2.setFont(u8g_font_tpssb);//fonte

  //Para inicializar o display 3
  PrintOnScreen(3);
  oled3.begin();
  oled3.firstPage();
  do {
    oled3.setColorIndex(0); // Define a cor como preto
    oled3.drawBox(0, 0, 128, 32); // Desenha um retângulo preto na tela
  } while (oled3.nextPage());
  oled3.setColorIndex(1);//white
  oled3.setFont(u8g_font_tpssb);//fonte

  //------------------------------------------------ FIM iniciando display apagado --------------------------------

  // intanciando portas
  pinMode(pinBed, OUTPUT);
  digitalWrite(pinBed, 1);

  pinMode(pinFAN, OUTPUT);
  analogWrite(pinFAN, 0);

  pinMode(pushButton, INPUT_PULLUP);

  //-------------------------- MENU INCIAL

  //Logo();
  initialMenu();
  FanSpeed(fanSpeed);
  delay(1000);
  printOnscreen03(TemperatureAlvo);
  ScreenPreviousMillis = millis();

}


enum Estado {
  wait1,
  printScreen1,
  wait2,
  printScreen2
};

Estado estadoAtual = wait1;

void loop() {
    int potFan = FanSpeed(map(analogRead(potentiometer), 0, 1023, 0, 11) * 10); //jogo na função resultado da multiplicação por 10 o valor do range do potenciometro de 0 a 10

    if(potFan != lastReadFanporcent){
      lastReadFanporcent = potFan;
      fanSpeed = potFan;
    }

    if(millis() - sensorPreviousMillis > delayControlTemp){//

      //------------------------------ Controle de temperatura ------------------------------
      ReadDHT();//função que ler os dados do dht e salva nas variavei globais humidity e temperature
      humidityAbsolute = calculaUmidadeAbsoluta(temperature, humidity); //Calculo de humidade absoluta em g/m3

      if(temperature < TemperatureAlvo){
        //liga hotbed
        digitalWrite(pinBed, 0);
      } else if(temperature > TemperatureAlvo){
        //Desliga hotbed
        digitalWrite(pinBed, 1);
      }
      //------------------------------ FIM controle temperatura ------------------------------


      Serial.println("");
      Serial.print("humidity: ");
      Serial.println(humidity, 1);

      Serial.print("temperature: ");
      Serial.println(temperature, 1);

      Serial.print("Humidity Absolute: ");
      Serial.println(humidityAbsolute);

      Serial.print("Temperature Alvo: ");
      Serial.println(TemperatureAlvo);

      Serial.print("Fan Speed: ");
      Serial.println(fanSpeed);

      sensorPreviousMillis = millis();
    }
  

  //Printando nas telas em tempos diferentes para não sobrecarregar o barramentro i2c
  switch (estadoAtual){
    case wait1:
      if(millis() - ScreenPreviousMillis > ScreenInterval){
        estadoAtual = printScreen1;
      }
      break;
    case printScreen1:
      printOnscreen01(temperature, humidity);
      estadoAtual = wait2;
      ScreenPreviousMillis = millis();
      break;
    case wait2:
      if(millis() - ScreenPreviousMillis > ScreenInterval){
        estadoAtual = printScreen2;
      }
      break;
    case printScreen2:
      printOnscreen02(humidityAbsolute, fanSpeed);

      estadoAtual = wait1;
      ScreenPreviousMillis = millis();
      break;
  }

}
